## dts/bindings/led/kinetic,ktd202x.yaml
```yaml
# Copyright (c) 2025 Crab Labs LLC
# SPDX-License-Identifier: Apache-2.0

description: |
  Kinetic KTD2026/KTD2027 I2C RGB/RGBW LED Controller

  The KTD2026 is a 3-channel and KTD2027 is a 4-channel constant current
  LED driver with I2C control. Features include individual LED brightness
  control, hardware PWM blinking, and programmable rise/fall times.

  I2C addresses:
    - KTD2026:  0x30
    - KTD2026B: 0x31
    - KTD2026C: 0x32
    - KTD2027:  0x30

  Example with single RGB LED (standard RGB wiring):

    ktd2026@30 {
      compatible = "kinetic,ktd202x";
      reg = <0x30>;
      status = "okay";
      wake-gpios = <&gpio1 4 (GPIO_ACTIVE_LOW | GPIO_OPEN_DRAIN)>;

      led_0 {
        label = "RGB LED";
        index = <0>;
        color-mapping = <LED_COLOR_ID_RED>,
                        <LED_COLOR_ID_GREEN>,
                        <LED_COLOR_ID_BLUE>;
      };
    };

  Example with channel remapping (e.g., RBG wiring where Blue is on LED2, Green on LED3):

    ktd2026@30 {
      compatible = "kinetic,ktd202x";
      reg = <0x30>;
      status = "okay";
      /* Maps: Red->LED1(ch0), Green->LED3(ch2), Blue->LED2(ch1) */
      channel-map = <0 2 1>;

      led_0 {
        label = "RGB LED";
        index = <0>;
        color-mapping = <LED_COLOR_ID_RED>,
                        <LED_COLOR_ID_GREEN>,
                        <LED_COLOR_ID_BLUE>;
      };
    };

  Example with three separate single-color LEDs:

    ktd2026@30 {
      compatible = "kinetic,ktd202x";
      reg = <0x30>;
      status = "okay";

      led_r {
        label = "Red LED";
        index = <0>;
        color-mapping = <LED_COLOR_ID_RED>;
      };

      led_g {
        label = "Green LED";
        index = <1>;
        color-mapping = <LED_COLOR_ID_GREEN>;
      };

      led_b {
        label = "Blue LED";
        index = <2>;
        color-mapping = <LED_COLOR_ID_BLUE>;
      };
    };

compatible: "kinetic,ktd202x"

include: ["i2c-device.yaml", "led-controller.yaml"]

properties:
  vin-supply:
    type: phandle
    description: Regulator that powers the KTD202x chip

  wake-gpios:
    type: phandle-array
    description: |
      Optional GPIO view of the I2C SDA line used to wake the controller from
      shutdown. The pin must be active-low and open-drain. The driver holds SDA
      low for at least 10 us, releases it, and waits for the controller wake
      delay before its first I2C transaction.

  "#address-cells":
    const: 1

  "#size-cells":
    const: 0

  channel-map:
    type: array
    description: |
      Optional hardware channel remapping array. Maps color indices from
      color-mapping to physical LED channels (LED1=0, LED2=1, LED3=2, LED4=3).

      This allows correcting for different LED wiring configurations:
        - RGB (default): <0 1 2> - Red->LED1, Green->LED2, Blue->LED3
        - RBG:           <0 2 1> - Red->LED1, Green->LED3, Blue->LED2
        - GRB:           <1 0 2> - Red->LED2, Green->LED1, Blue->LED3
        - GBR:           <2 0 1> - Red->LED3, Green->LED1, Blue->LED2
        - BRG:           <1 2 0> - Red->LED2, Green->LED3, Blue->LED1
        - BGR:           <2 1 0> - Red->LED3, Green->LED2, Blue->LED1

      If not specified, direct mapping (RGB) is used.

child-binding:
  description: LED channel configuration
  properties:
    reg:
      type: int
      required: true
      description: |
        LED index (0-based). For a single RGB LED, use 0.
        For separate LED definitions, use sequential indices (0, 1, 2...).

    label:
      type: string
      required: true
      description: Human-readable label for the LED

    color-mapping:
      type: array
      required: true
      description: |
        Color mapping for the LED. Use LED_COLOR_ID_* constants from
        dt-bindings/led/led.h. For RGB LEDs, specify all three colors
        in the order you want to use them (typically RED, GREEN, BLUE).
        The channel-map property controls the physical mapping.
```
